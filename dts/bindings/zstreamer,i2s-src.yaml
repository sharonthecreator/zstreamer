## dts/bindings/zstreamer,i2s-src.yaml
```yaml
# Copyright (c) 2026 sharonthecreator
# SPDX-License-Identifier: Apache-2.0

description: |
  I2S source node. Configures the referenced I2S/SAI peripheral as
  master receiver with 32-bit slots and streams one channel as
  int16 PCM (top 16 signal bits of each 24-bit-in-32 I2S word).
  Suited to MEMS microphones like the INMP441, which require the
  64-SCK-per-frame ratio that 32-bit slots produce.

compatible: "zstreamer,i2s-src"

include: zstreamer,src.yaml

properties:
  i2s-device:
    type: phandle
    required: true
    description: I2S RX peripheral to capture from (e.g. an STM32 SAI block).

  sample-rate-hz:
    type: int
    required: true
    description: Frame clock (sample) rate in Hz.

  channel:
    type: string
    default: "left"
    enum:
      - "left"
      - "right"
    description: |
      Which slot of the 2-slot I2S frame to keep.  Must match how the mic's
      channel-select pin is strapped (INMP441 L/R: GND = left, VDD = right) --
      a mismatch reads the undriven slot, whose contents are undefined.
```

## dts/bindings/zstreamer,looper-node.yaml
```yaml
description: |
  Looper processor node for zstreamer.
  Retransmits each incoming net_buf a configurable number of times,
  e.g. for reliability over lossy transports.

  The gap between retransmissions is either fixed (delay-ms) or drawn
  uniformly from [random-delay-min-ms, random-delay-max-ms] per gap.
  Configure exactly one of the two forms — setting delay-ms together
  with the random-delay properties fails at build time.  Random delays
  need a random source in the build (e.g. CONFIG_ENTROPY_GENERATOR=y
  with an entropy driver).

compatible: "zstreamer,looper-node"

include: zstreamer,node.yaml

properties:
  retransmit-count:
    type: int
    default: 3
    description: Total number of times to forward each buffer.
  delay-ms:
    type: int
    description: |
      Fixed delay in milliseconds between retransmissions.  Omitted
      (with no random-delay-* either) means no delay.  Mutually
      exclusive with random-delay-min-ms/random-delay-max-ms.
  random-delay-min-ms:
    type: int
    description: |
      Lower bound (ms) of the uniform random delay between
      retransmissions.  Requires random-delay-max-ms; mutually
      exclusive with delay-ms.
  random-delay-max-ms:
    type: int
    description: |
      Upper bound (ms, inclusive) of the uniform random delay between
      retransmissions.  Requires random-delay-min-ms; mutually
      exclusive with delay-ms.
```

## dts/bindings/zstreamer,lora-sink.yaml
```yaml
# Copyright (c) 2026 sharonthecreator
# SPDX-License-Identifier: Apache-2.0

description: |
  LoRa sink node. Transmits each received buffer as a LoRa packet using
  the Zephyr LoRa driver API with blocking lora_send().

compatible: "zstreamer,lora-sink"

include: zstreamer,sink.yaml

properties:
  lora-device:
    type: phandle
    required: true
    description: |
      Reference to the LoRa radio device node (e.g., &lora).
  frequency:
    type: int
    default: 865100000
    description: |
      LoRa carrier frequency in Hz (e.g., 865100000 for 865.1 MHz).
  bandwidth:
    type: int
    default: 0
    description: |
      Signal bandwidth enum value from Zephyr lora_signal_bandwidth.
      Common values: 10 = 10.42 kHz, 125 = 125 kHz, 250 = 250 kHz, 500 = 500 kHz.
  spreading-factor:
    type: int
    default: 10
    description: |
      Spreading factor (6-12). Higher values increase range but reduce data rate.
  coding-rate:
    type: int
    default: 1
    description: |
      Coding rate: 1 = 4/5, 2 = 4/6, 3 = 4/7, 4 = 4/8.
  preamble-length:
    type: int
    default: 8
    description: |
      Preamble length in symbols.
  tx-power:
    type: int
    default: 14
    description: |
      Transmit power in dBm.
  switch-gpios:
    type: phandle-array
    description: |
      Optional GPIO spec for a 2-position frequency-select switch, read once
      at first configure. When set, overrides frequency with frequency-low
      (pin reads 0) or frequency-high (pin reads 1). Omit to use frequency
      unconditionally (backward-compatible default).
  frequency-low:
    type: int
    description: |
      Carrier frequency in Hz when switch-gpios reads 0. Only meaningful
      with switch-gpios set; defaults to frequency if unset.
  frequency-high:
    type: int
    description: |
      Carrier frequency in Hz when switch-gpios reads 1. Only meaningful
      with switch-gpios set; defaults to frequency if unset.
```

## dts/bindings/zstreamer,lora-src.yaml
```yaml
# Copyright (c) 2026 sharonthecreator
# SPDX-License-Identifier: Apache-2.0

description: |
  LoRa source node. Receives LoRa packets and produces buffers containing
  the received payload bytes. Uses the Zephyr LoRa driver API with
  blocking lora_recv().

  With switch-gpios set, RX is broken off every couple of seconds to re-read
  the switch, since lora_recv() cannot be aborted. Each break drops a packet
  that happens to be mid-air, so expect a few percent loss and rely on
  sender-side retransmits.

compatible: "zstreamer,lora-src"

include: zstreamer,src.yaml

properties:
  lora-device:
    type: phandle
    required: true
    description: |
      Reference to the LoRa radio device node (e.g., &lora).
  frequency:
    type: int
    default: 865100000
    description: |
      LoRa carrier frequency in Hz (e.g., 865100000 for 865.1 MHz).
  bandwidth:
    type: int
    default: 0
    description: |
      Signal bandwidth enum value from Zephyr lora_signal_bandwidth.
      Common values: 10 = 10.42 kHz, 125 = 125 kHz, 250 = 250 kHz, 500 = 500 kHz.
  spreading-factor:
    type: int
    default: 10
    description: |
      Spreading factor (6-12). Higher values increase range but reduce data rate.
  coding-rate:
    type: int
    default: 1
    description: |
      Coding rate: 1 = 4/5, 2 = 4/6, 3 = 4/7, 4 = 4/8.
  preamble-length:
    type: int
    default: 8
    description: |
      Preamble length in symbols.
  tx-power:
    type: int
    default: 14
    description: |
      Transmit power in dBm (used during config, though this is RX).
  switch-gpios:
    type: phandle-array
    description: |
      Optional GPIO spec for a 2-position frequency-select switch, re-read
      every couple of seconds so the band can be changed while running --
      note this makes reception periodic rather than continuous (see the
      node description). When set, overrides frequency with frequency-low
      (pin reads 0) or frequency-high (pin reads 1). Omit to use frequency
      unconditionally (backward-compatible default).
  frequency-low:
    type: int
    description: |
      Carrier frequency in Hz when switch-gpios reads 0. Only meaningful
      with switch-gpios set; defaults to frequency if unset.
  frequency-high:
    type: int
    description: |
      Carrier frequency in Hz when switch-gpios reads 1. Only meaningful
      with switch-gpios set; defaults to frequency if unset.
```

## dts/bindings/zstreamer,numgen-src.yaml
```yaml
# Copyright (c) 2026 sharonthecreator
# SPDX-License-Identifier: Apache-2.0

description: |
  Number generator source node. Produces sequential bytes 0-255
  (wrapping) to fill each buffer completely. Software-only test node.

compatible: "zstreamer,numgen-src"

include: zstreamer,src.yaml

properties:
  sleep-ms:
    type: int
    default: 1
    description: |
      Milliseconds to sleep after filling each buffer. Controls the
      production rate and allows simulated time to advance on native_sim.
```

## dts/bindings/zstreamer,odd-filter.yaml
```yaml
# Copyright (c) 2026 sharonthecreator
# SPDX-License-Identifier: Apache-2.0

description: |
  Odd-byte filter node. Returns true if the first byte of a buffer
  is odd, false if even. Software-only test node.

compatible: "zstreamer,odd-filter"

include: zstreamer,filter.yaml
```

## dts/bindings/zstreamer,opus-decode-node.yaml
```yaml
# Copyright (c) 2026 sharonthecreator
# SPDX-License-Identifier: Apache-2.0

description: |
  Opus decoder processor node. Parses the self-delimiting stream
  produced by the opus-encode-node (12-byte stream header, then
  length-prefixed Opus packets) and emits one buffer of 16-bit
  little-endian interleaved PCM per decoded frame. Input buffer
  boundaries may split headers and packets arbitrarily. The stream
  header's sample rate and channel count must match this node's
  properties; mismatched or corrupt input is dropped until the next
  stream START event.

compatible: "zstreamer,opus-decode-node"

include: zstreamer,node.yaml

properties:
  sample-rate-hz:
    type: int
    default: 16000
    enum: [8000, 12000, 16000, 24000, 48000]
    description: PCM sample rate of the decoded output in Hz.

  channels:
    type: int
    default: 1
    enum: [1, 2]
    description: Number of interleaved PCM channels.
```

## dts/bindings/zstreamer,opus-encode-node.yaml
```yaml
# Copyright (c) 2026 sharonthecreator
# SPDX-License-Identifier: Apache-2.0

description: |
  Opus encoder processor node. Consumes 16-bit little-endian
  interleaved PCM and emits a self-delimiting encoded stream: a
  12-byte stream header per stream start, then length-prefixed Opus
  packets. A fresh header is emitted after every in-band stream START
  event, so each stream segment (e.g. each file written by fs-sink)
  is decodable on its own. On STOP the partial frame is zero-padded
  and flushed ahead of the event.

compatible: "zstreamer,opus-encode-node"

include: zstreamer,node.yaml

properties:
  sample-rate-hz:
    type: int
    default: 16000
    enum: [8000, 12000, 16000, 24000, 48000]
    description: PCM sample rate of the input stream in Hz.

  channels:
    type: int
    default: 1
    enum: [1, 2]
    description: Number of interleaved PCM channels.

  frame-ms:
    type: int
    default: 20
    enum: [10, 20, 40, 60]
    description: Opus frame duration in milliseconds.

  bitrate-bps:
    type: int
    default: 24000
    description: Target Opus bitrate in bits per second.
```

## dts/bindings/zstreamer,pdm-src.yaml
```yaml
description: |
  ADF-based PDM microphone source with hardware CIC decimation.

  Configures the STM32U5 Audio Digital Filter (ADF1) to receive a PDM
  bitstream on ADF1_SDI0, clock the microphone from ADF1_CCK0, and
  decimate with the hardware Sinc4 CIC filter (DFLT0).  GPDMA transfers
  decimated signed int16 PCM samples from the DFLT0 data register into
  the zstreamer pipeline.

  The node must supply two ``clocks`` entries: the ADF1 bus clock and
  the ADF1 kernel clock source.  Pin configuration for ADF1_CCK0 (clock
  output) and ADF1_SDI0 (data input) must be provided via pinctrl.

  Example (Nucleo-U5A5ZJ-Q, Knowles SPK0641HT4H-1)::

    pdm_source: pdm-source {
        compatible = "zstreamer,pdm-src";
        clocks = <&rcc STM32_CLOCK(AHB3, 10)>,
                 <&rcc STM32_SRC_MSIK ADF1_SEL(4)>;
        sample-rate-hz = <16000>;
        pdm-clk-freq-hz = <2000000>;
        pinctrl-0 = <&adf1_cck0_pf3 &adf1_sdi0_pf4>;
        pinctrl-names = "default";
        dmas = <&gpdma1 0 98 (STM32_DMA_PERIPH_RX |
                                STM32_DMA_MEM_16BITS |
                                STM32_DMA_PERIPH_16BITS)>;
        dma-names = "rx";
        children = <&some_filter>;
        autostart;
    };

compatible: "zstreamer,pdm-src"

include:
  - "zstreamer,src.yaml"
  - pinctrl-device.yaml

properties:
  clocks:
    type: phandle-array
    required: true
    description: |
      Two clock entries:
        [0] ADF1 bus clock on AHB3 (e.g. <&rcc STM32_CLOCK(AHB3, 10)>).
        [1] ADF1 kernel clock source (e.g. <&rcc STM32_SRC_MSIK ADF1_SEL(4)>).
      The kernel clock feeds the ADF clock generator which produces the
      PDM bit-clock on CCK0.

  sample-rate-hz:
    type: int
    required: true
    description: |
      Output PCM sample rate in Hz (e.g. 16000).  Must evenly divide
      pdm-clk-freq-hz to produce an integer decimation ratio.

  pdm-clk-freq-hz:
    type: int
    default: 2048000
    description: |
      PDM bit-clock frequency in Hz output on ADF1_CCK0.
      SPK0641HT4H-1 supports 1.0 -- 4.8 MHz.  Default 2.048 MHz
      gives a clean decimation ratio of 128 at 16 kHz PCM output.

  right-channel:
    type: boolean
    description: |
      Capture the right PDM channel (rising-edge data) instead of the
      default left channel (falling-edge data).  Set this when the
      microphone Select pin is tied to VDD.

  dmas:
    type: phandle-array
    required: true
    description: |
      GPDMA channel for ADF1 DFLT0 RX.  Format:
      <&gpdma1 channel request flags>.  The request slot for
      ADF1_FLT0 is 98 (GPDMA1_REQUEST_ADF1_FLT0).

  dma-names:
    type: string-array
    required: true
    description: Must be "rx".

  warmup-buffers:
    type: int
    default: 0
    description: |
      Number of initial half-buffers to silently discard after DMA
      starts.  PDM microphones need a settling period; the first few
      buffers contain transient noise that can trigger false detections
      downstream.  Set to 0 to disable (default).
```

## dts/bindings/zstreamer,random-timer-src.yaml
```yaml
description: |
  Random timer source for zstreamer.
  Generates an empty buffer at random intervals between
  min-range-seconds and max-range-seconds.

compatible: "zstreamer,random-timer-src"

include: zstreamer,src.yaml

properties:
  min-range-seconds:
    type: int
    required: true
    description: Minimum interval in seconds between buffer emissions.
  max-range-seconds:
    type: int
    required: true
    description: Maximum interval in seconds between buffer emissions.
```

## dts/bindings/zstreamer,sine-src.yaml
```yaml
# Copyright (c) 2026 sharonthecreator
# SPDX-License-Identifier: Apache-2.0

description: |
  Sine wave source node. Produces a sine waveform as unsigned bytes
  (0-255, centered at 128) based on wall-clock time. The cycle-ms
  property sets the duration of one full sine period in milliseconds.
  Software-only test node.

compatible: "zstreamer,sine-src"

include: zstreamer,src.yaml

properties:
  cycle-ms:
    type: int
    default: 1000
    description: |
      Duration of one full sine cycle in milliseconds. For example,
      cycle-ms = 500 produces a 2 Hz sine wave.
```

## dts/bindings/zstreamer,sink.yaml
```yaml
# Copyright (c) 2026 sharonthecreator
# SPDX-License-Identifier: Apache-2.0

description: |
  zstreamer sink node. Sink nodes are terminal — they consume
  buffers but never distribute to children. The children property
  is deliberately absent from this binding.

compatible: "zstreamer,sink"

include: zstreamer,node.yaml
```
