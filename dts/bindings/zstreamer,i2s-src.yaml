## dts/bindings/zstreamer,stereo-deinterleaver-node.yaml
```yaml
# Copyright (c) 2026 sharonthecreator
# SPDX-License-Identifier: Apache-2.0

description: |
  16-bit stereo deinterleaver processor node for zstreamer.

  The node treats each input buffer as interleaved 16-bit stereo samples and
  emits separate left and right buffers. An input laid out as L0, R0, L1, R1
  becomes an L0, L1 buffer sent to left-children and an R0, R1 buffer sent to
  right-children. Sample signedness and byte order are preserved.

    stereo-deinterleaver {
      compatible = "zstreamer,stereo-deinterleaver-node";
      left-children = <&left_sink>;
      right-children = <&right_sink>;
    };

  Buffers that do not contain a whole number of stereo frames are dropped.
  The node holds the input while allocating both output buffers, so the graph's
  buffer-count must be greater than two, in addition to any buffers needed
  elsewhere in the pipeline.

compatible: "zstreamer,stereo-deinterleaver-node"

include:
  - name: zstreamer,node.yaml
    property-blocklist:
      - children

properties:
  left-children:
    type: phandles
    required: true
    description: Downstream node(s) that receive the left-channel buffers.

  right-children:
    type: phandles
    required: true
    description: Downstream node(s) that receive the right-channel buffers.
```

## dts/bindings/zstreamer,uart-src.yaml
```yaml
# Copyright (c) 2026 sharonthecreator
# SPDX-License-Identifier: Apache-2.0

description: |
  UART source node. Reads bytes from a UART device using poll_in
  and submits them as buffers to downstream children.

compatible: "zstreamer,uart-src"

include: zstreamer,src.yaml

properties:
  uart-device:
    type: phandle
    required: true
    description: Phandle to the UART device to read from.
  message-size:
    type: int
    default: 0
    description: |
      Expected message size in bytes. When set (> 0), the source
      accumulates bytes until this many have been received before
      dispatching the buffer. A 50 ms timeout prevents indefinite
      blocking if the full message never arrives.
```

## dts/bindings/zstreamer/zstreamer,count-sink.yaml
```yaml
# Copyright (c) 2026 sharonthecreator
# SPDX-License-Identifier: Apache-2.0

description: |
  Counting sink node. Counts received buffers and bytes via atomics.
  Software-only test node.

compatible: "zstreamer,count-sink"

include: zstreamer,sink.yaml
```

## dts/bindings/zstreamer/zstreamer,filter.yaml
```yaml
# Copyright (c) 2026 sharonthecreator
# SPDX-License-Identifier: Apache-2.0

description: |
  zstreamer filter node. Filter nodes receive buffers, run a
  boolean filter callback, and distribute the buffer to either
  the children (filter returns true) or the false-children
  (filter returns false).

compatible: "zstreamer,filter"

include: zstreamer,node.yaml

properties:
  false-children:
    type: phandles
    description: |
      Downstream node(s) for the filter-false path.
```

## dts/bindings/zstreamer/zstreamer,node.yaml
```yaml
# Copyright (c) 2026 sharonthecreator
# SPDX-License-Identifier: Apache-2.0

description: |
  Base binding for zstreamer streaming node devices.
  All zstreamer node driver bindings should include this file
  (via one of the type-specific intermediaries: src, sink,
  or filter) or directly for through-nodes.

compatible: "zstreamer,node"

include: base.yaml

properties:
  thread-stack-size:
    type: int
    default: 1024
    description: Stack size in bytes for the node thread.

  thread-priority:
    type: int
    default: 5
    description: Priority of the node thread.

  children:
    type: phandles
    description: |
      Downstream node(s) that this node sends buffers to.
      For fan-out, list multiple phandles.
      Optional — sinks and leaf nodes omit this property.
```

## dts/bindings/zstreamer/zstreamer,passthrough-node.yaml
```yaml
# Copyright (c) 2026 sharonthecreator
# SPDX-License-Identifier: Apache-2.0

description: |
  Passthrough through-node. Forwards buffers unchanged to children.
  Software-only test node.

compatible: "zstreamer,passthrough-node"

include: zstreamer,node.yaml
```

## dts/bindings/zstreamer/zstreamer,processor.yaml
```yaml
# Copyright (c) 2026 sharonthecreator
# SPDX-License-Identifier: Apache-2.0

description: |
  zstreamer processor node. Processor nodes receive buffers, run
  a process callback to transform them, and distribute the result
  to their children.

compatible: "zstreamer,processor"

include: zstreamer,node.yaml

properties:
  children:
    type: phandles
    description: |
      Downstream node(s) that this processor sends buffers to.
      For fan-out, list multiple phandles.
```

## dts/bindings/zstreamer/zstreamer,pwm-sink.yaml
```yaml
# Copyright (c) 2026 sharonthecreator
# SPDX-License-Identifier: Apache-2.0

description: |
  PWM sink node. Maps the mean value of each received buffer to a PWM
  duty cycle. Useful for driving LEDs or other PWM-controlled actuators
  whose output should correlate with streamed data.

compatible: "zstreamer,pwm-sink"

include: zstreamer,sink.yaml

properties:
  pwms:
    type: phandle-array
    required: true
    description: |
      PWM channel to drive. Specifies the PWM controller, channel,
      and default period in nanoseconds.
  min-value:
    type: int
    default: 0
    description: |
      Input byte value that maps to 0% duty cycle. Values at or
      below this produce no PWM output.
  max-value:
    type: int
    default: 255
    description: |
      Input byte value that maps to 100% duty cycle. Values at or
      above this produce full PWM output.
```

## dts/bindings/zstreamer/zstreamer,sink.yaml
```yaml
# Copyright (c) 2026 sharonthecreator
# SPDX-License-Identifier: Apache-2.0

description: |
  zstreamer sink node. Sink nodes run in their own thread and
  consume buffers by blocking on their fifo and calling the
  driver's process callback for each received buffer.

compatible: "zstreamer,sink"

include: zstreamer,node.yaml
```

## dts/bindings/zstreamer/zstreamer,src.yaml
```yaml
# Copyright (c) 2026 sharonthecreator
# SPDX-License-Identifier: Apache-2.0

description: |
  zstreamer source node. Source nodes run in their own thread and
  produce buffers by calling the driver's generate callback in a loop.
  They distribute produced buffers to their children.

compatible: "zstreamer,src"

include: zstreamer,node.yaml

properties:
  children:
    type: phandles
    description: |
      Downstream node(s) that this source sends buffers to.
      For fan-out, list multiple phandles.
```

## lib/zstreamer/Kconfig
```kconfig
# Copyright (c) 2026 zstreamer contributors
# SPDX-License-Identifier: Apache-2.0

module = ZSTREAMER
module-str = zstreamer
source "subsys/logging/Kconfig.template.log_config"
```

## samples/adc2uart/sample.yaml
```yaml
# Copyright (c) 2026 sharonthecreator
# SPDX-License-Identifier: Apache-2.0

sample:
  name: ADC audio to UART
  description: |
    Demonstrates the STM32 timer-triggered ADC DMA source: TIM6 TRGO
    paces ADC4 at 16 kHz, circular DMA double-buffers the samples, and
    the pipeline streams them as raw int16 PCM out LPUART1 at 921600
    baud (capture with an FTDI adapter on PG7).
tests:
  sample.zstreamer.adc2uart:
    tags: zstreamer
    platform_allow: nucleo_u5a5zj_q
```

## samples/button2led/sample.yaml
```yaml
# Copyright (c) 2026 sharonthecreator
# SPDX-License-Identifier: Apache-2.0

sample:
  name: Button to LED pulses
  description: |
    Demonstrates button-src press-type routing and looper-node random
    delays: a short press of B1 pulses the blue LED once via
    gpio-pulse-node; a long press (>= 3 s) routes to a looper that
    replays the pulse 5 times with a random 500-1500 ms gap.
tests:
  sample.zstreamer.button2led:
    tags: zstreamer
    platform_allow: nucleo_wl55jc
```
