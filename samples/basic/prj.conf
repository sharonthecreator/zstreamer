## CMakeLists.txt
```
# Copyright (c) 2026 zstreamer contributors
# SPDX-License-Identifier: Apache-2.0

cmake_minimum_required(VERSION 3.20.0)
find_package(Zephyr REQUIRED HINTS $ENV{ZEPHYR_BASE})
project(zstreamer_basic_sample)

target_sources(app PRIVATE src/main.c)
```

## sample.yaml
```
# Copyright (c) 2026 zstreamer contributors
# SPDX-License-Identifier: Apache-2.0

sample:
  name: zstreamer basic sample
  description: Basic sample demonstrating the zstreamer framework
tests:
  sample.zstreamer.basic:
    tags: zstreamer
    depends_on: []
```

## prj.conf
```kconfig
# Copyright (c) 2026 zstreamer contributors
# SPDX-License-Identifier: Apache-2.0

CONFIG_ZSTREAMER=y
CONFIG_ZSTNODE=y
CONFIG_LOG=y
```

## src/main.c
```c
/*
 * Copyright (c) 2026 zstreamer contributors
 * SPDX-License-Identifier: Apache-2.0
 */

#include <zephyr/kernel.h>
#include <zephyr/logging/log.h>

#include <zstreamer/zstreamer.h>

LOG_MODULE_REGISTER(zstreamer_sample, LOG_LEVEL_INF);

int main(void)
{
	LOG_INF("zstreamer basic sample");

	return 0;
}
```
