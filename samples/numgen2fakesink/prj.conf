## CMakeLists.txt
```
# Copyright (c) 2026 sharonthecreator
# SPDX-License-Identifier: Apache-2.0

cmake_minimum_required(VERSION 3.20.0)
find_package(Zephyr REQUIRED HINTS $ENV{ZEPHYR_BASE})
project(numgen2fakesink)

target_sources(app PRIVATE src/main.c)
```

## sample.yaml
```
# Copyright (c) 2026 sharonthecreator
# SPDX-License-Identifier: Apache-2.0

sample:
  name: Number generator to fake sink
  description: |
    Demonstrates a software-only streaming pipeline using numgen-src
    (generates sequential bytes 0-255) piped to fake-sink (discards data).
tests:
  sample.zstreamer.numgen2fakesink:
    tags: zstreamer
    platform_allow: nucleo_u575zi_q
```

## prj.conf
```kconfig
# Copyright (c) 2026 sharonthecreator
# SPDX-License-Identifier: Apache-2.0

CONFIG_ZSTREAMER=y
CONFIG_ZSTREAMER_TEST_NUMGEN_SRC=y
CONFIG_ZSTREAMER_TEST_FAKE_SINK=y
CONFIG_LOG=y
```

## boards/native_sim.overlay
```dts
/*
 * Copyright (c) 2026 sharonthecreator
 * SPDX-License-Identifier: Apache-2.0
 *
 * Number generator to fake sink on native_sim.
 * Software-only pipeline — no hardware dependencies.
 */

/ {
	streaming_graph: streaming-graph {
		compatible = "zstreamer,graph";
		buffer-count = <8>;
		buffer-size = <128>;

		numgen_source: numgen-source {
			compatible = "zstreamer,numgen-src";
			children = <&fake_sinker>;
			autostart;
		};

		fake_sinker: fake-sinker {
			compatible = "zstreamer,fake-sink";
		};
	};
};
```

## boards/native_sim_native_64.overlay
```dts
/*
 * Copyright (c) 2026 sharonthecreator
 * SPDX-License-Identifier: Apache-2.0
 *
 * Number generator to fake sink on native_sim.
 * Software-only pipeline — no hardware dependencies.
 */

/ {
	streaming_graph: streaming-graph {
		compatible = "zstreamer,graph";
		buffer-count = <8>;
		buffer-size = <128>;

		numgen_source: numgen-source {
			compatible = "zstreamer,numgen-src";
			children = <&fake_sinker>;
		};

		fake_sinker: fake-sinker {
			compatible = "zstreamer,fake-sink";
		};
	};
};
```

## boards/nucleo_u575zi_q.overlay
```dts
/*
 * Copyright (c) 2026 sharonthecreator
 * SPDX-License-Identifier: Apache-2.0
 *
 * Number generator to fake sink on Nucleo U575ZI-Q.
 * Software-only pipeline — no hardware dependencies.
 */

/ {
	streaming_graph: streaming-graph {
		compatible = "zstreamer,graph";
		buffer-count = <8>;
		buffer-size = <128>;

		numgen_source: numgen-source {
			compatible = "zstreamer,numgen-src";
			children = <&fake_sinker>;
			autostart;
		};

		fake_sinker: fake-sinker {
			compatible = "zstreamer,fake-sink";
		};
	};
};
```

## src/main.c
```c
/*
 * Copyright (c) 2026 sharonthecreator
 * SPDX-License-Identifier: Apache-2.0
 */
```
