## samples/lora2pwm/sample.yaml
```yaml
# Copyright (c) 2026 sharonthecreator
# SPDX-License-Identifier: Apache-2.0

sample:
  name: LoRa to PWM
  description: |
    Demonstrates a lora-src -> pwm-sink streaming pipeline.
    Received LoRa data drives the blue and red LEDs via PWM.
tests:
  sample.zstreamer.lora2pwm:
    tags: zstreamer
    platform_allow: nucleo_wl55jc
```

## samples/sine2lora/sample.yaml
```yaml
# Copyright (c) 2026 sharonthecreator
# SPDX-License-Identifier: Apache-2.0

sample:
  name: Sine wave to LoRa
  description: |
    Demonstrates a sine-src -> {lora-sink, pwm-sink} streaming pipeline
    that transmits a time-based sine wave over LoRa while driving the
    red LED brightness via PWM.
tests:
  sample.zstreamer.sine2lora:
    tags: zstreamer
    platform_allow: nucleo_wl55jc
```

## tests/drivers/adc/testcase.yaml
```yaml
# Copyright (c) 2026 sharonthecreator
# SPDX-License-Identifier: Apache-2.0

tests:
  drivers.zstreamer.adc:
    tags: drivers zstreamer adc
    platform_allow:
      - native_sim
```

## tests/drivers/codec/testcase.yaml
```yaml
# Copyright (c) 2026 sharonthecreator
# SPDX-License-Identifier: Apache-2.0

tests:
  drivers.zstreamer.codec:
    tags: drivers zstreamer codec opus
    platform_allow:
      - native_sim
```

## tests/drivers/decoupler/testcase.yaml
```yaml
# Copyright (c) 2026 sharonthecreator
# SPDX-License-Identifier: Apache-2.0

tests:
  drivers.zstreamer.decoupler:
    tags: drivers zstreamer decoupler
    platform_allow:
      - native_sim
```

## tests/drivers/distribute/testcase.yaml
```yaml
# Copyright (c) 2026 sharonthecreator
# SPDX-License-Identifier: Apache-2.0

tests:
  drivers.zstreamer.distribute:
    tags: drivers zstreamer distribute
    platform_allow:
      - native_sim
```

## tests/drivers/filter/testcase.yaml
```yaml
# Copyright (c) 2026 sharonthecreator
# SPDX-License-Identifier: Apache-2.0

tests:
  drivers.zstreamer.filter:
    tags: drivers zstreamer filter
    platform_allow:
      - native_sim
```

## tests/drivers/fs/testcase.yaml
```yaml
# Copyright (c) 2026 sharonthecreator
# SPDX-License-Identifier: Apache-2.0

tests:
  drivers.zstreamer.fs:
    tags: drivers zstreamer fs
    platform_allow:
      - native_sim
```

## tests/drivers/node/testcase.yaml
```yaml
# Copyright (c) 2026 sharonthecreator
# SPDX-License-Identifier: Apache-2.0

tests:
  drivers.zstreamer.node:
    tags: drivers zstreamer node
    platform_allow:
      - native_sim
```

## tests/drivers/node_spi/testcase.yaml
```yaml
# Copyright (c) 2026 sharonthecreator
# SPDX-License-Identifier: Apache-2.0

tests:
  drivers.zstreamer_node.spi:
    tags: drivers zstreamer_node zstreamer spi
    platform_allow:
      - native_sim
      - native_sim/native/64
```

## tests/drivers/processor/testcase.yaml
```yaml
# Copyright (c) 2026 sharonthecreator
# SPDX-License-Identifier: Apache-2.0

tests:
  drivers.zstreamer_node.processor:
    tags: drivers zstreamer_node zstreamer processor
    platform_allow:
      - native_sim
      - native_sim/native/64
```

## tests/drivers/pwm/testcase.yaml
```yaml
# Copyright (c) 2026 sharonthecreator
# SPDX-License-Identifier: Apache-2.0

tests:
  drivers.zstreamer.pwm:
    tags: drivers zstreamer pwm
    platform_allow:
      - native_sim
```

## tests/drivers/sink/testcase.yaml
```yaml
# Copyright (c) 2026 sharonthecreator
# SPDX-License-Identifier: Apache-2.0

tests:
  drivers.zstreamer.sink:
    tags: drivers zstreamer sink
    platform_allow:
      - native_sim
```

## tests/drivers/source/testcase.yaml
```yaml
# Copyright (c) 2026 sharonthecreator
# SPDX-License-Identifier: Apache-2.0

tests:
  drivers.zstreamer.source:
    tags: drivers zstreamer source
    platform_allow:
      - native_sim
```

## tests/drivers/spi/testcase.yaml
```yaml
# Copyright (c) 2026 sharonthecreator
# SPDX-License-Identifier: Apache-2.0

tests:
  drivers.zstreamer.spi:
    tags: drivers zstreamer spi
    platform_allow:
      - native_sim
```

## tests/drivers/stereo_deinterleaver/testcase.yaml
```yaml
# Copyright (c) 2026 sharonthecreator
# SPDX-License-Identifier: Apache-2.0

tests:
  drivers.zstreamer.stereo_deinterleaver:
    tags: drivers zstreamer stereo deinterleaver
    platform_allow:
      - native_sim
```

## tests/drivers/uart/testcase.yaml
```yaml
# Copyright (c) 2026 sharonthecreator
# SPDX-License-Identifier: Apache-2.0

tests:
  drivers.zstreamer.uart:
    tags: drivers zstreamer uart
    platform_allow:
      - native_sim
```

## tests/drivers/util/testcase.yaml
```yaml
# Copyright (c) 2026 sharonthecreator
# SPDX-License-Identifier: Apache-2.0

tests:
  drivers.zstreamer.util:
    tags: drivers zstreamer util
    platform_allow:
      - native_sim
```

## tests/drivers/zstnode/testcase.yaml
```yaml
# Copyright (c) 2026 sharonthecreator
# SPDX-License-Identifier: Apache-2.0

tests:
  drivers.zstnode.uart:
    tags: drivers zstnode zstreamer uart
    platform_allow:
      - native_sim
      - native_sim/native/64
      - qemu_cortex_m3
```

## tests/drivers/zstnode_spi/testcase.yaml
```yaml
# Copyright (c) 2026 sharonthecreator
# SPDX-License-Identifier: Apache-2.0

tests:
  drivers.zstnode.spi:
    tags: drivers zstnode zstreamer spi
    platform_allow:
      - native_sim
      - native_sim/native/64
```

## tests/subsys/distribute/testcase.yaml
```yaml
# Copyright (c) 2026 sharonthecreator
# SPDX-License-Identifier: Apache-2.0

tests:
  subsys.zstreamer.distribute:
    tags: subsys zstreamer distribute
    platform_allow:
      - native_sim
```

## tests/subsys/events/testcase.yaml
```yaml
# Copyright (c) 2026 sharonthecreator
# SPDX-License-Identifier: Apache-2.0

tests:
  subsys.zstreamer.events:
    tags: subsys zstreamer events
    platform_allow:
      - native_sim
```

## tests/subsys/filter/testcase.yaml
```yaml
# Copyright (c) 2026 sharonthecreator
# SPDX-License-Identifier: Apache-2.0

tests:
  subsys.zstreamer.filter:
    tags: subsys zstreamer filter
    platform_allow:
      - native_sim
```

## tests/subsys/node/testcase.yaml
```yaml
# Copyright (c) 2026 sharonthecreator
# SPDX-License-Identifier: Apache-2.0

tests:
  subsys.zstreamer.node:
    tags: subsys zstreamer node
    platform_allow:
      - native_sim
```

## west.yml
```yaml
# Copyright (c) 2026 sharonthecreator
# SPDX-License-Identifier: Apache-2.0

manifest:
  version: "1.0"

  defaults:
    remote: zephyrproject-rtos

  remotes:
    - name: zephyrproject-rtos
      url-base: https://github.com/zephyrproject-rtos

  projects:
    - name: zephyr
      remote: zephyrproject-rtos
      revision: main
      import:
        name-allowlist:
          - cmsis_6
          - hal_stm32
          - littlefs
          - loramac-node
    - name: opus
      url: https://github.com/xiph/opus
      revision: v1.5.2
      path: modules/lib/opus

  self:
    path: modules/zstreamer
```
