## drivers/zstreamer/test/Kconfig
```kconfig
# Copyright (c) 2026 sharonthecreator
# SPDX-License-Identifier: Apache-2.0

config ZSTREAMER_TEST
	bool

config ZSTREAMER_TEST_NUMGEN_SRC
	bool "Number generator source driver"
	depends on DT_HAS_ZSTREAMER_NUMGEN_SRC_ENABLED
	depends on ZSTREAMER
	select ZSTREAMER_TEST
	help
	  Enable the number generator source streaming node driver.
	  Produces sequential bytes 0-255 (wrapping) to fill each buffer.

config ZSTREAMER_TEST_FAKE_SINK
	bool "Fake sink driver"
	depends on DT_HAS_ZSTREAMER_FAKE_SINK_ENABLED
	depends on ZSTREAMER
	select ZSTREAMER_TEST
	help
	  Enable the fake sink streaming node driver.
	  Discards all received buffer data.
```

## drivers/zstreamer/uart/Kconfig
```kconfig
# Copyright (c) 2026 sharonthecreator
# SPDX-License-Identifier: Apache-2.0

config ZSTREAMER_NODE_UART_SRC
	bool "UART source zstreamer_node driver"
	default y
	depends on DT_HAS_ZSTREAMER_SRC_UART_ENABLED
	depends on ZSTREAMER_NODE
	depends on SERIAL
	help
	  Enable the UART source streaming node driver.
	  Reads bytes from a UART device and submits them
	  as buffers into the streaming graph.

config ZSTREAMER_NODE_UART_SINK
	bool "UART sink zstreamer_node driver"
	default y
	depends on DT_HAS_ZSTREAMER_SINK_UART_ENABLED
	depends on ZSTREAMER_NODE
	depends on SERIAL
	help
	  Enable the UART sink streaming node driver.
	  Writes received buffer data to a UART device.

config ZSTREAMER_NODE_UART_DMA
	bool "UART DMA/async support for zstreamer_node"
	default y
	depends on UART_ASYNC_API
	depends on (ZSTREAMER_NODE_UART_SRC || ZSTREAMER_NODE_UART_SINK)
	help
	  Enable DMA/async UART support for zstreamer_node drivers.
	  When enabled, UART source and sink nodes will automatically
	  use DMA transfers when available, falling back to polling
	  if the UART device doesn't support async API.

config ZSTREAMER_NODE_UART_DMA_MAX_CONTEXTS
	int "Maximum number of UART DMA contexts"
	default 4
	depends on ZSTREAMER_NODE_UART_DMA
	help
	  Maximum number of UART devices that can simultaneously use
	  DMA with the shared context system. Each UART device that
	  has both a source and sink node sharing DMA uses one context.

config ZSTREAMER_NODE_UART_DMA_RX_BUF_SIZE
	int "UART DMA RX buffer size"
	default 256
	depends on ZSTREAMER_NODE_UART_DMA
	help
	  Size in bytes of the DMA receive buffer for UART source nodes.
	  Larger buffers can reduce interrupt overhead but use more RAM.
```

## dts/bindings/streaming/zstnode.yaml
```yaml
# Copyright (c) 2026 zstreamer contributors
# SPDX-License-Identifier: Apache-2.0

description: |
  Base binding for zstnode streaming node devices.
  All zstnode driver bindings should include this file.

compatible: "zstreamer,zstnode"

include: base.yaml

properties:
  children:
    type: phandles
    description: |
      Downstream node(s) that this node sends buffers to.
      For fan-out, list multiple phandles.
```

## dts/bindings/streaming/zstreamer,graph.yaml
```yaml
# Copyright (c) 2026 sharonthecreator
# SPDX-License-Identifier: Apache-2.0

description: |
  zstreamer graph container node. Child nodes represent streaming
  pipeline nodes (sources, sinks, generic processors). The graph
  owns a net_buf_pool shared by all its children.

compatible: "zstreamer,graph"

include: base.yaml

properties:
  buffer-count:
    type: int
    default: 8
    description: Number of buffers in the graph net_buf pool.

  buffer-size:
    type: int
    default: 2048
    description: Size in bytes of each buffer in the graph net_buf pool.

  "#address-cells":
    type: int
    const: 1

  "#size-cells":
    type: int
    const: 0
```

## dts/bindings/streaming/zstreamer,sink-fake.yaml
```yaml
# Copyright (c) 2026 sharonthecreator
# SPDX-License-Identifier: Apache-2.0

description: |
  Fake sink node. Discards all received buffer data.
  Software-only test node.

compatible: "zstreamer,sink-fake"

include: zstreamer,sink.yaml
```

## dts/bindings/streaming/zstreamer,sink-fs.yaml
```yaml
# Copyright (c) 2026 sharonthecreator
# SPDX-License-Identifier: Apache-2.0

description: |
  File system sink node. Writes received buffer data to files,
  rotating based on time or size thresholds.

compatible: "zstreamer,sink-fs"

include: zstreamer,sink.yaml

properties:
  mount-path:
    type: string
    required: true
    description: Directory path where files are saved (e.g. "/lfs/data").

  delta-ms-threshold:
    type: int
    default: 0
    description: Max time in ms before rotating to a new file. 0 = disabled.

  size-threshold:
    type: int
    default: 0
    description: Max bytes per file before rotating. 0 = disabled.
```

## dts/bindings/streaming/zstreamer,sink-spi.yaml
```yaml
# Copyright (c) 2026 sharonthecreator
# SPDX-License-Identifier: Apache-2.0

description: |
  SPI sink node. Writes received buffer data to an SPI device
  (as master).

  The spi-device phandle must reference a device node that is a
  child of an SPI bus controller. SPI bus parameters (frequency,
  cpol, cpha, chip-select) are taken from that device node.

compatible: "zstreamer,sink-spi"

include: zstreamer,sink.yaml

properties:
  spi-device:
    type: phandle
    required: true
    description: |
      Phandle to an SPI peripheral device node (a child of an SPI
      bus controller). SPI configuration (frequency, mode, CS) is
      derived from this node's standard SPI properties.
```

## dts/bindings/streaming/zstreamer,src-uart.yaml
```yaml
# Copyright (c) 2026 sharonthecreator
# SPDX-License-Identifier: Apache-2.0

description: |
  UART source node. Reads bytes from a UART device using poll_in
  and submits them as buffers to downstream children.

compatible: "zstreamer,src-uart"

include: zstreamer,src.yaml

properties:
  uart-device:
    type: phandle
    required: true
    description: Phandle to the UART device to read from.
```

## dts/bindings/streaming/zstreamer,src.yaml
```yaml
# Copyright (c) 2026 sharonthecreator
# SPDX-License-Identifier: Apache-2.0

description: |
  zstreamer source node. Source nodes run in their own thread and
  produce buffers by calling the driver's run callback in a loop.

compatible: "zstreamer,src"

include: zstreamer,node.yaml
```

## dts/bindings/streaming/zstreamer,zstsink-spi.yaml
```yaml
# Copyright (c) 2026 zstreamer contributors
# SPDX-License-Identifier: Apache-2.0

description: |
  SPI sink node. Writes received buffer data to an SPI device
  (as master).

compatible: "zstreamer,zstsink-spi"

include: zstreamer,zstsink.yaml

properties:
  spi-device:
    type: phandle
    required: true
    description: Phandle to the SPI bus controller.

  spi-cs-gpios:
    type: phandle-array
    description: |
      GPIO for chip select. If not specified, hardware CS is used.

  spi-max-frequency:
    type: int
    default: 1000000
    description: Maximum SPI clock frequency in Hz.

  spi-cpol:
    type: boolean
    description: Set clock polarity (CPOL=1).

  spi-cpha:
    type: boolean
    description: Set clock phase (CPHA=1).
```

## dts/bindings/streaming/zstreamer,zstsink-uart.yaml
```yaml
# Copyright (c) 2026 sharonthecreator
# SPDX-License-Identifier: Apache-2.0

description: |
  UART sink node. Writes received buffer data to a UART device
  using poll_out.

compatible: "zstreamer,zstsink-uart"

include: zstreamer,zstsink.yaml

properties:
  uart-device:
    type: phandle
    required: true
    description: Phandle to the UART device to write to.
```

## dts/bindings/streaming/zstreamer,zstsink.yaml
```yaml
# Copyright (c) 2026 zstreamer contributors
# SPDX-License-Identifier: Apache-2.0

description: |
  zstreamer sink node. Sink nodes run in their own thread and
  consume buffers by blocking on their fifo and calling the
  driver's process callback for each received buffer.

compatible: "zstreamer,zstsink"

include: zstnode.yaml

properties:
  thread-stack-size:
    type: int
    default: 1024
    description: Stack size in bytes for the sink thread.

  thread-priority:
    type: int
    default: 5
    description: Priority of the sink thread.
```

## dts/bindings/streaming/zstreamer,zstsrc-numgen.yaml
```yaml
# Copyright (c) 2026 sharonthecreator
# SPDX-License-Identifier: Apache-2.0

description: |
  Number generator source node. Produces sequential bytes 0-255
  (wrapping) to fill each buffer completely. Software-only test node.

compatible: "zstreamer,zstsrc-numgen"

include: zstreamer,zstsrc.yaml
```

## dts/bindings/streaming/zstreamer,zstsrc-spi.yaml
```yaml
# Copyright (c) 2026 zstreamer contributors
# SPDX-License-Identifier: Apache-2.0

description: |
  SPI source node. Reads bytes from an SPI device (as master)
  and submits them as buffers to downstream children.

compatible: "zstreamer,zstsrc-spi"

include: zstreamer,zstsrc.yaml

properties:
  spi-device:
    type: phandle
    required: true
    description: Phandle to the SPI bus controller.

  spi-cs-gpios:
    type: phandle-array
    description: |
      GPIO for chip select. If not specified, hardware CS is used.

  spi-max-frequency:
    type: int
    default: 1000000
    description: Maximum SPI clock frequency in Hz.

  spi-cpol:
    type: boolean
    description: Set clock polarity (CPOL=1).

  spi-cpha:
    type: boolean
    description: Set clock phase (CPHA=1).

  rx-length:
    type: int
    default: 64
    description: |
      Number of bytes to read in each SPI transaction.
      For continuous streaming, set this to the expected frame size.
```

## dts/bindings/streaming/zstreamer,zstsrc.yaml
```yaml
# Copyright (c) 2026 zstreamer contributors
# SPDX-License-Identifier: Apache-2.0

description: |
  zstreamer source node. Source nodes run in their own thread and
  produce buffers by calling the driver's run callback in a loop.

compatible: "zstreamer,zstsrc"

include: zstnode.yaml

properties:
  thread-stack-size:
    type: int
    default: 1024
    description: Stack size in bytes for the source thread.

  thread-priority:
    type: int
    default: 5
    description: Priority of the source thread.
```

## dts/bindings/zstreamer,adc-dma-stm32-src.yaml
```yaml
description: |
  Timer-triggered STM32 ADC source with circular DMA for continuous
  capture (e.g. audio).

  A hardware timer's TRGO triggers ADC conversions at sample-rate-hz.
  DMA moves results in circular mode into a double buffer; half-transfer
  and transfer-complete interrupts wake the source thread, which emits
  one half-buffer per pipeline buffer as signed int16 PCM (DC offset
  removed).  With the default oversampling (ratio 16, no shift) a 12-bit
  ADC yields full-scale 16-bit samples.

  STM32-only: uses STM32 LL for trigger, unlimited-DMA mode, sequencer
  and oversampling setup.  Channel gain/reference/acquisition time come
  from the ADC channel's own DTS child node via the standard Zephyr ADC
  API, so the referenced ADC controller must be status "okay".  The ADC
  instance is used exclusively by this node — do not adc_read() it from
  elsewhere.

  The driver cannot verify that the timer phandle actually routes to the
  EXTSEL input named by st,trigger — check the chip reference manual.

  Example (STM32U5, ADC4 + TIM6 + GPDMA1):

    adc_dma_source: adc-dma-source {
        compatible = "zstreamer,adc-dma-stm32-src";
        io-channels = <&adc4 10>;
        sample-rate-hz = <16000>;
        timer = <&timers6>;
        st,trigger = "tim6-trgo-adc4";
        dmas = <&gpdma1 0 1 (STM32_DMA_PERIPH_RX |
                             STM32_DMA_MEM_16BITS |
                             STM32_DMA_PERIPH_16BITS)>;
        dma-names = "rx";
        children = <&some_filter>;
        autostart;
    };

  Example (STM32WL55, ADC + TIM2 + DMA1/DMAMUX, request 5 = ADC):

    adc_dma_source: adc-dma-source {
        compatible = "zstreamer,adc-dma-stm32-src";
        io-channels = <&adc1 3>;
        sample-rate-hz = <16000>;
        timer = <&timers2>;
        st,trigger = "tim2-trgo";
        dmas = <&dmamux1 0 5 (STM32_DMA_PERIPH_RX |
                              STM32_DMA_MEM_16BITS |
                              STM32_DMA_PERIPH_16BITS)>;
        dma-names = "rx";
        children = <&some_filter>;
    };

compatible: "zstreamer,adc-dma-stm32-src"

include: zstreamer,src.yaml

properties:
  io-channels:
    type: phandle-array
    required: true
    description: |
      Single ADC channel to sample: <&adcN chan>.  The ADC register
      base and sequencer flavor (st,adc-sequencer) are derived from the
      referenced controller node at compile time.

  sample-rate-hz:
    type: int
    required: true
    description: Target sampling rate in Hz (e.g. 16000).

  timer:
    type: phandle
    required: true
    description: |
      st,stm32-timers node whose update-event TRGO paces conversions.
      Must be a master-capable timer wired to the ADC EXTSEL input
      selected by st,trigger (chip-specific).

  st,trigger:
    type: string
    required: true
    description: |
      ADC external trigger source, as the suffix of the series LL enum
      LL_ADC_REG_TRIG_EXT_<TOKEN> (lowercased, '-' for '_'), e.g.
      "tim6-trgo" -> LL_ADC_REG_TRIG_EXT_TIM6_TRGO.  On STM32U5's ADC4
      the LL enums carry an _ADC4 suffix: use e.g. "tim6-trgo-adc4".
      A trigger that doesn't exist on the target series fails to
      compile.

  oversampling-ratio:
    type: int
    default: 16
    enum: [0, 2, 4, 8, 16, 32, 64, 128, 256]
    description: |
      Hardware oversampling ratio, no right shift (0 disables).  The
      default 16 with a 12-bit ADC produces 16-bit samples, matching
      the driver's int16 output convention.

  dmas:
    type: phandle-array
    required: true
    description: |
      DMA channel spec.  The request line is taken from the "slot"
      cell (GPDMA request / DMAMUX request ID); transfers are always
      peripheral-to-memory, 16-bit.

  dma-names:
    type: string-array
    required: true
    description: Must be "rx".
```

## dts/bindings/zstreamer,adc-src.yaml
```yaml
# Copyright (c) 2026 sharonthecreator
# SPDX-License-Identifier: Apache-2.0

description: |
  ADC source node for zstreamer pipeline.

  Captures ADC samples using Zephyr's portable ADC API (blocking reads
  in the source thread).  Supports any number of channels via the
  io-channels property.  Resolution and gain are taken from the ADC
  channel's own DTS properties (zephyr,resolution, zephyr,gain, etc.).

  Example for dual-channel at 1 kHz:

    adc_source: adc-source {
        compatible = "zstreamer,adc-src";
        io-channels = <&adc1 0>, <&adc1 1>;
        sample-rate-hz = <1000>;
        samples = <64>;
        children = <&some_sink>;
    };

compatible: "zstreamer,adc-src"

include: zstreamer,src.yaml

properties:
  io-channels:
    type: phandle-array
    required: true
    description: |
      ADC channel(s) to sample.  Each entry is a phandle to an ADC
      controller and channel number.

  sample-rate-hz:
    type: int
    required: true
    description: |
      Target sampling rate in Hz.  The driver sleeps between read
      batches to approximate this rate; the actual rate depends on
      ADC conversion time.

  samples:
    type: int
    default: 64
    description: |
      Number of sample frames per streaming buffer.  Each frame
      contains one sample per channel.  Larger values reduce overhead
      but increase latency.
```
