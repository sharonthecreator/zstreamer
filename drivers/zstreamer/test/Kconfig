## dts/bindings/zstreamer,batch-node.yaml
```yaml
# Copyright (c) 2026 sharonthecreator
# SPDX-License-Identifier: Apache-2.0

description: |
  Batch processor node for zstreamer.
  Holds incoming net_bufs until batch-count have accumulated, then
  releases them all downstream in arrival order.  Turns a steady
  stream into periodic bursts — e.g. SD-card writes every N buffers
  so the card idles between bursts.

  Held buffers stay allocated from the shared graph pool, so
  batch-count must stay below the graph's buffer-count by at least
  the pipeline's working set (enforced at build time only against
  buffer-count itself).  If the stream stops mid-batch, up to
  batch-count - 1 buffers stay held until the stream resumes.

compatible: "zstreamer,batch-node"

include: zstreamer,node.yaml

properties:
  batch-count:
    type: int
    required: true
    description: |
      Number of buffers to accumulate before releasing the whole
      batch downstream.
```

## dts/bindings/zstreamer,button-src.yaml
```yaml
description: |
  Button source for zstreamer.

  Emits exactly one empty buffer per button press, routed by press type:
  short presses go to children, long presses (held >= long-press-ms,
  when long-press-ms > 0) go to long-press-children.  Hold detection is
  done by polling the GPIO level inside process().

  For a one-shot fixed burst with no cancel/refresh behavior, periodic
  emission can still be composed downstream instead — e.g. wire
  long-press-children to a looper-node to turn one long press into N
  paced emissions:

    button_src: button-src {
        compatible = "zstreamer,button-src";
        gpios = <&gpioc 13 GPIO_ACTIVE_HIGH>;
        long-press-ms = <5000>;
        children = <&encode_node>;
        long-press-children = <&burst_looper>;
        autostart;
    };

    burst_looper: burst-looper {
        compatible = "zstreamer,looper-node";
        retransmit-count = <90>;
        delay-ms = <10000>;
        children = <&encode_node>;
    };

  A looper-node's retransmit loop blocks its caller for the full burst
  duration, and here that caller would be button_src's own thread — so
  the button could not react to any press for that whole span.  When a
  long-held sequence needs to stay responsive to new presses (cancel on
  short press, refresh on a repeated long press), use periodic-count /
  periodic-interval-ms instead: button_src drives the repeat itself off
  a system-workqueue timer, leaving its own thread free to keep polling
  for presses:

    button_src: button-src {
        compatible = "zstreamer,button-src";
        gpios = <&gpioc 13 GPIO_ACTIVE_HIGH>;
        long-press-ms = <5000>;
        children = <&encode_node>;
        long-press-children = <&encode_node>;
        periodic-count = <90>;
        periodic-interval-ms = <10000>;
        autostart;
    };

  A long press emits immediately, then re-emits to long-press-children
  every periodic-interval-ms until periodic-count total emissions have
  gone out.  A short press always emits to children as usual, and also
  cancels an in-progress periodic sequence.  A long press while a
  sequence is already running restarts it from the top (full count,
  timer reset) rather than stacking a second one.

compatible: "zstreamer,button-src"

include: zstreamer,src.yaml

properties:
  gpios:
    type: phandle-array
    required: true
    description: GPIO spec for the button input (e.g. user button).

  long-press-ms:
    type: int
    default: 5000
    description: |
      How long (ms) the button must stay held for the press to route to
      long-press-children.  Released before this threshold is a short
      press (routed to children).  0 disables long-press detection
      entirely.

  long-press-children:
    type: phandles
    description: |
      Downstream node(s) for long presses.  Omitted (or empty) means
      long presses are dropped.

  periodic-count:
    type: int
    description: |
      Total number of emissions to long-press-children per long-press
      sequence (the immediate one plus periodic-count - 1 more, paced
      periodic-interval-ms apart), after which the sequence stops on
      its own.  Omitted (or the pair below omitted) means a long press
      emits exactly once, as if this feature didn't exist.  Must be
      paired with periodic-interval-ms.

  periodic-interval-ms:
    type: int
    description: |
      Gap in ms between periodic re-emissions once a long press has
      started a sequence.  Must be paired with periodic-count.
```

## dts/bindings/zstreamer,dac-sink.yaml
```yaml
# Copyright (c) 2026 sharonthecreator
# SPDX-License-Identifier: Apache-2.0

description: |
  DAC sink node for zstreamer pipeline.

  Receives buffers of interleaved samples and writes each frame to the
  configured DAC channel(s) using Zephyr's portable DAC API.

  Single-channel example (12-bit DAC on channel 0):

    dac_sinker: dac-sinker {
        compatible = "zstreamer,dac-sink";
        dac-device = <&dac1>;
        dac-channel-ids = <0>;
        dac-resolution = <12>;
    };

  Multi-channel example (stereo 12-bit DAC):

    dac_sinker: dac-sinker {
        compatible = "zstreamer,dac-sink";
        dac-device = <&dac1>;
        dac-channel-ids = <0 1>;
        dac-resolution = <12>;
    };

compatible: "zstreamer,dac-sink"

include: zstreamer,sink.yaml

properties:
  dac-device:
    type: phandle
    required: true
    description: DAC device to output samples to.

  dac-channel-ids:
    type: array
    required: true
    description: |
      DAC channel number(s).  For multi-channel output, samples in
      the buffer are interleaved across channels (one sample per
      channel per frame).

  dac-resolution:
    type: int
    default: 12
    description: DAC output resolution in bits (shared by all channels).
```

## dts/bindings/zstreamer,decoupler-node.yaml
```yaml
# Copyright (c) 2026 sharonthecreator
# SPDX-License-Identifier: Apache-2.0

description: |
  Stereo decoupler processor node for zstreamer.

  The node treats each input buffer as left-right-interleaved elements and
  emits separate left and right buffers.  For example, with element-size = <2>,
  a uint16_t input laid out as left, right, left, right becomes one all-left
  buffer sent to left-children and one all-right buffer sent to right-children:

    stereo-decoupler {
      compatible = "zstreamer,decoupler-node";
      element-size = <2>;
      left-children = <&left_sink>;
      right-children = <&right_sink>;
    };

  Buffers that do not contain a whole number of stereo frames are dropped.
  The node holds the input while allocating both output buffers, so the graph's
  buffer-count must be greater than two, in addition to any buffers needed
  elsewhere in the pipeline.

compatible: "zstreamer,decoupler-node"

include:
  - name: zstreamer,node.yaml
    property-blocklist:
      - children

properties:
  element-size:
    type: int
    required: true
    description: Size of one left or right element in bytes.

  left-children:
    type: phandles
    required: true
    description: Downstream node(s) that receive the left-channel buffers.

  right-children:
    type: phandles
    required: true
    description: Downstream node(s) that receive the right-channel buffers.
```

## dts/bindings/zstreamer,fs-mounted-filter.yaml
```yaml
description: |
  Filesystem mount gate for zstreamer.
  Checks once (on the first buffer) whether a filesystem is mounted at
  mount-path. If mounted, passes all buffers to children. If not, drops
  all buffers.

compatible: "zstreamer,fs-mounted-filter"

include: zstreamer,filter.yaml

properties:
  mount-path:
    type: string
    required: true
    description: Filesystem mount path to check (e.g. "/SD:").
```

## dts/bindings/zstreamer,fs-sink.yaml
```yaml
# Copyright (c) 2026 sharonthecreator
# SPDX-License-Identifier: Apache-2.0

description: |
  File system sink node. Writes received buffer data to files,
  rotating based on time or size thresholds.

compatible: "zstreamer,fs-sink"

include: zstreamer,sink.yaml

properties:
  mount-path:
    type: string
    required: true
    description: Directory path where files are saved (e.g. "/lfs/data").

  filename-prefix:
    type: string
    default: ""
    description: >
      Prefix inserted before the file index in generated filenames.
      E.g. "data_" produces "data_00000.bin". Empty string by default.

  delta-ms-threshold:
    type: int
    default: 0
    description: Max time in ms before rotating to a new file. 0 = disabled.

  size-threshold:
    type: int
    default: 0
    description: Max bytes per file before rotating. 0 = disabled.

  file-count:
    type: int
    default: 0
    description: Max number of files before wrapping index to 0. 0 = unlimited.

  max-write-size:
    type: int
    default: 0
    description: Max bytes per fs_write call. Large buffers are chunked. 0 = no limit.

  sync-each-buffer:
    type: boolean
    description: >
      fs_sync() after every buffer instead of only on rotation. Without it the
      most recently written file is left open, and on FAT its directory entry
      still reads size 0 until the *next* buffer triggers a rotation -- so a
      reboot or power cut loses it. Set this on sparse streams, where that next
      buffer may be hours away. Costs a directory-sector read plus a couple of
      sector writes per buffer, so leave it off for continuous streams that
      rotate often on their own.
```

## dts/bindings/zstreamer,gpio-pulse-node.yaml
```yaml
description: |
  GPIO pulse processor node for zstreamer.
  Sets a GPIO pin HIGH when a buffer arrives, passes it downstream,
  then sets the pin LOW after a configurable hold time.

compatible: "zstreamer,gpio-pulse-node"

include: zstreamer,node.yaml

properties:
  gpios:
    type: phandle-array
    required: true
    description: GPIO pin to pulse (output, active high).
  hold-ms:
    type: int
    default: 500
    description: |
      Time in milliseconds to keep the pin HIGH after a buffer arrives.
  delay-ms:
    type: int
    default: 200
    description: |
      Delay in milliseconds after raising the pin before forwarding the
      buffer downstream.  Must be long enough for the downstream
      peripheral to be ready (e.g. an MCU booting after an NRST reset).
```
