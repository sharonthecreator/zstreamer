## Kconfig
```kconfig
# Copyright (c) 2026 zstreamer contributors
# SPDX-License-Identifier: Apache-2.0

menuconfig ZSTREAMER
	bool "zstreamer streaming framework"
	select NET_BUF
	help
	  Enable the zstreamer streaming framework module.
	  zstreamer provides a streaming pipeline framework for
	  embedded systems running Zephyr RTOS.

if ZSTREAMER

rsource "lib/zstreamer/Kconfig"
rsource "drivers/zstnode/Kconfig"

endif # ZSTREAMER
```

## drivers/Kconfig
```kconfig
# Copyright (c) 2026 sharonthecreator
# SPDX-License-Identifier: Apache-2.0

rsource "uart/Kconfig"

rsource "spi/Kconfig"

rsource "adc/Kconfig"

rsource "i2s/Kconfig"

rsource "dac/Kconfig"

rsource "fs/Kconfig"

rsource "pwm/Kconfig"

rsource "lora/Kconfig"

rsource "gpio/Kconfig"

rsource "util/Kconfig"

rsource "test/Kconfig"
```

## drivers/adc/Kconfig
```kconfig
# Copyright (c) 2026 sharonthecreator
# SPDX-License-Identifier: Apache-2.0

config ZSTREAMER_ADC
	bool

config ZSTREAMER_ADC_SRC
	bool "ADC source driver"
	depends on DT_HAS_ZSTREAMER_ADC_SRC_ENABLED
	depends on ZSTREAMER
	depends on ADC
	select ZSTREAMER_ADC
	help
	  Enable the ADC source streaming node driver.
	  Captures ADC samples using Zephyr's portable ADC API
	  (blocking adc_read in the source thread).

config ZSTREAMER_ADC_DMA_STM32_SRC
	bool "STM32 timer-triggered ADC DMA source driver"
	depends on DT_HAS_ZSTREAMER_ADC_DMA_STM32_SRC_ENABLED
	depends on ZSTREAMER
	depends on ADC
	depends on DMA
	depends on SOC_FAMILY_STM32
	select ZSTREAMER_ADC
	help
	  Enable the STM32 timer-triggered ADC DMA source driver.
	  A timer's TRGO paces ADC conversions; circular DMA streams
	  results into a double buffer emitted as int16 PCM.  Uses STM32
	  LL for trigger/DMA-unlimited/oversampling setup.
```

## drivers/codec/Kconfig
```kconfig
# Copyright (c) 2026 sharonthecreator
# SPDX-License-Identifier: Apache-2.0

config ZSTREAMER_CODEC
	bool

config ZSTREAMER_OPUS
	bool
	help
	  Build libopus (fixed-point, float API disabled, pseudostack)
	  from the opus west project.  The pseudostack build keeps codec
	  scratch memory out of thread stacks: libopus allocates a
	  ~120 kB arena from the libc heap on the first codec call and
	  becomes non-reentrant, so all libopus calls are serialized by
	  a shared mutex.

config ZSTREAMER_OPUS_ENCODE_NODE
	bool "Opus encoder node driver"
	depends on DT_HAS_ZSTREAMER_OPUS_ENCODE_NODE_ENABLED
	depends on ZSTREAMER
	select ZSTREAMER_CODEC
	select ZSTREAMER_OPUS
	help
	  Enable the Opus encoder streaming node driver.
	  Consumes 16-bit LE PCM and emits a self-delimiting stream of
	  a 12-byte header plus length-prefixed Opus packets.

config ZSTREAMER_OPUS_DECODE_NODE
	bool "Opus decoder node driver"
	depends on DT_HAS_ZSTREAMER_OPUS_DECODE_NODE_ENABLED
	depends on ZSTREAMER
	select ZSTREAMER_CODEC
	select ZSTREAMER_OPUS
	help
	  Enable the Opus decoder streaming node driver.
	  Parses the stream produced by the encoder node and emits
	  16-bit LE PCM frames.

config ZSTREAMER_OPUS_THREAD_STACK_SIZE
	int "Opus codec node thread stack size"
	depends on ZSTREAMER_OPUS
	default 12288
	help
	  Stack size for Opus codec node threads.  Even with the
	  pseudostack build (scratch in a heap arena), encode/decode
	  calls need ~7.4 kB of real stack (measured on 32-bit x86),
	  which cannot fit the fixed ZSTREAMER_THREAD_STACK_SIZE, so
	  codec nodes run on their own larger stack.
```

## drivers/dac/Kconfig
```kconfig
# Copyright (c) 2026 sharonthecreator
# SPDX-License-Identifier: Apache-2.0

config ZSTREAMER_DAC
	bool

config ZSTREAMER_DAC_SINK
	bool "DAC sink driver"
	depends on DT_HAS_ZSTREAMER_DAC_SINK_ENABLED
	depends on ZSTREAMER
	depends on DAC
	select ZSTREAMER_DAC
	help
	  Enable the DAC sink streaming node driver.
	  Writes received uint16_t samples to a DAC channel
	  using Zephyr's portable DAC API.
```

## drivers/fs/Kconfig
```kconfig
# Copyright (c) 2026 sharonthecreator
# SPDX-License-Identifier: Apache-2.0

config ZSTREAMER_FS
	bool

config ZSTREAMER_FS_SINK
	bool "File system sink driver"
	depends on DT_HAS_ZSTREAMER_FS_SINK_ENABLED
	depends on ZSTREAMER
	depends on FILE_SYSTEM
	select ZSTREAMER_FS
	help
	  Enable the file system sink streaming node driver.
	  Writes streamed data to files, rotating based on time or size.

config ZSTREAMER_FS_MOUNTED_FILTER
	bool "Filesystem mount gate filter driver"
	depends on DT_HAS_ZSTREAMER_FS_MOUNTED_FILTER_ENABLED
	depends on ZSTREAMER
	depends on FILE_SYSTEM
	select ZSTREAMER_FS
	help
	  Enable the filesystem mount gate filter driver.
	  Checks once (on the first buffer) whether a filesystem is mounted
	  at mount-path; if so, passes all buffers, otherwise drops them.
```

## drivers/gpio/Kconfig
```kconfig
# Copyright (c) 2026 sharonthecreator
# SPDX-License-Identifier: Apache-2.0

config ZSTREAMER_GPIO
	bool

config ZSTREAMER_GPIO_PULSE_NODE
	bool "GPIO pulse processor node driver"
	depends on DT_HAS_ZSTREAMER_GPIO_PULSE_NODE_ENABLED
	depends on ZSTREAMER
	depends on GPIO
	select ZSTREAMER_GPIO
	help
	  Enable the GPIO pulse processor node driver.
	  Raises a GPIO pin when a buffer arrives, forwards the buffer after
	  a configurable delay, and drops the pin after a configurable hold
	  time — e.g. to wake a downstream MCU before sending to it.

config ZSTREAMER_GPIO_BUTTON_SRC
	bool "Button source driver"
	depends on DT_HAS_ZSTREAMER_BUTTON_SRC_ENABLED
	depends on ZSTREAMER
	depends on GPIO
	select ZSTREAMER_GPIO
	help
	  Enable the button source streaming node driver.
	  Emits one empty buffer per button press, routed by press type:
	  short presses to children, long presses to long-press-children.
```

## drivers/i2s/Kconfig
```kconfig
# Copyright (c) 2026 sharonthecreator
# SPDX-License-Identifier: Apache-2.0

config ZSTREAMER_I2S
	bool

config ZSTREAMER_I2S_SRC
	bool "I2S source driver"
	depends on DT_HAS_ZSTREAMER_I2S_SRC_ENABLED
	depends on ZSTREAMER
	depends on I2S
	select ZSTREAMER_I2S
	help
	  Enable the I2S source streaming node driver.
	  Master-receives 32-bit-slot stereo I2S frames (e.g. from an
	  INMP441 MEMS microphone via an STM32 SAI block) and emits the
	  left channel as int16 PCM.
```

## drivers/lora/Kconfig
```kconfig
# Copyright (c) 2026 sharonthecreator
# SPDX-License-Identifier: Apache-2.0

config ZSTREAMER_LORA
	bool

config ZSTREAMER_LORA_SRC
	bool "LoRa source driver"
	depends on DT_HAS_ZSTREAMER_LORA_SRC_ENABLED
	depends on ZSTREAMER
	depends on LORA
	select ZSTREAMER_LORA
	help
	  Enable the LoRa source streaming node driver.
	  Receives LoRa packets and produces buffers.

config ZSTREAMER_LORA_SINK
	bool "LoRa sink driver"
	depends on DT_HAS_ZSTREAMER_LORA_SINK_ENABLED
	depends on ZSTREAMER
	depends on LORA
	select ZSTREAMER_LORA
	help
	  Enable the LoRa sink streaming node driver.
	  Transmits each received buffer as a LoRa packet.
```

## drivers/pdm/Kconfig
```kconfig
# Copyright (c) 2026 sharonthecreator
# SPDX-License-Identifier: Apache-2.0

config ZSTREAMER_PDM
	bool

config ZSTREAMER_PDM_SRC
	bool "PDM microphone source driver"
	depends on DT_HAS_ZSTREAMER_PDM_SRC_ENABLED
	depends on ZSTREAMER
	depends on DMA
	depends on PINCTRL
	depends on SOC_FAMILY_STM32
	select ZSTREAMER_PDM
	help
	  Enable the ADF-based PDM microphone source streaming node.
	  Configures the STM32U5 ADF1 hardware CIC decimation filter
	  with DMA to produce signed int16 PCM samples.
```

## drivers/spi/Kconfig
```kconfig
# Copyright (c) 2026 sharonthecreator
# SPDX-License-Identifier: Apache-2.0

config ZSTREAMER_SPI
	bool

config ZSTREAMER_SPI_SRC
	bool "SPI source driver"
	depends on DT_HAS_ZSTREAMER_SPI_SRC_ENABLED
	depends on ZSTREAMER
	depends on SPI
	select ZSTREAMER_SPI
	help
	  Enable the SPI source streaming node driver.
	  Reads bytes from an SPI device (as master) and submits them
	  as buffers into the streaming graph.

config ZSTREAMER_SPI_SINK
	bool "SPI sink driver"
	depends on DT_HAS_ZSTREAMER_SPI_SINK_ENABLED
	depends on ZSTREAMER
	depends on SPI
	select ZSTREAMER_SPI
	help
	  Enable the SPI sink streaming node driver.
	  Writes received buffer data to an SPI device (as master).

config ZSTREAMER_SPI_DMA_RX_BUF_SIZE
	int "SPI DMA RX buffer size"
	default 256
	depends on SPI_ASYNC
	depends on ZSTREAMER_SPI_SRC
	help
	  Size in bytes of the intermediate receive buffer used for
	  async SPI reads. Only used when SPI_ASYNC is available.
```

## drivers/test/Kconfig
```kconfig
# Copyright (c) 2026 sharonthecreator
# SPDX-License-Identifier: Apache-2.0

config ZSTREAMER_TEST
	bool

config ZSTREAMER_TEST_NUMGEN_SRC
	bool "Number generator source driver"
	depends on DT_HAS_ZSTREAMER_NUMGEN_SRC_ENABLED
	depends on ZSTREAMER
	select ZSTREAMER_TEST
	help
	  Enable the number generator source streaming node driver.
	  Produces sequential bytes 0-255 (wrapping) to fill each buffer.

config ZSTREAMER_TEST_FAKE_SINK
	bool "Fake sink driver"
	depends on DT_HAS_ZSTREAMER_FAKE_SINK_ENABLED
	depends on ZSTREAMER
	select ZSTREAMER_TEST
	help
	  Enable the fake sink streaming node driver.
	  Discards all received buffer data.

config ZSTREAMER_TEST_COUNT_SINK
	bool "Counting sink driver"
	depends on DT_HAS_ZSTREAMER_COUNT_SINK_ENABLED
	depends on ZSTREAMER
	select ZSTREAMER_TEST
	help
	  Enable the counting sink streaming node driver.
	  Counts received buffers and bytes via atomics.

config ZSTREAMER_TEST_PASSTHROUGH_NODE
	bool "Passthrough through-node driver"
	depends on DT_HAS_ZSTREAMER_PASSTHROUGH_NODE_ENABLED
	depends on ZSTREAMER
	select ZSTREAMER_TEST
	help
	  Enable the passthrough through-node streaming node driver.
	  Forwards buffers unchanged to children.

config ZSTREAMER_TEST_ODD_FILTER
	bool "Odd-byte filter driver"
	depends on DT_HAS_ZSTREAMER_ODD_FILTER_ENABLED
	depends on ZSTREAMER
	select ZSTREAMER_TEST
	help
	  Enable the odd-byte filter streaming node driver.
	  Routes buffers based on whether the first byte is odd or even.

config ZSTREAMER_TEST_SINE_SRC
	bool "Sine wave source driver"
	depends on DT_HAS_ZSTREAMER_SINE_SRC_ENABLED
	depends on ZSTREAMER
	select ZSTREAMER_TEST
	help
	  Enable the sine wave source streaming node driver.
	  Produces a sine waveform as unsigned bytes (0-255).
```

## drivers/uart/Kconfig
```kconfig
# Copyright (c) 2026 sharonthecreator
# SPDX-License-Identifier: Apache-2.0

config ZSTREAMER_UART
	bool

config ZSTREAMER_UART_SRC
	bool "UART source driver"
	depends on DT_HAS_ZSTREAMER_UART_SRC_ENABLED
	depends on ZSTREAMER
	depends on SERIAL
	select ZSTREAMER_UART
	help
	  Enable the UART source streaming node driver.
	  Reads bytes from a UART device and submits them
	  as buffers into the streaming graph.

config ZSTREAMER_UART_SINK
	bool "UART sink driver"
	depends on DT_HAS_ZSTREAMER_UART_SINK_ENABLED
	depends on ZSTREAMER
	depends on SERIAL
	select ZSTREAMER_UART
	help
	  Enable the UART sink streaming node driver.
	  Writes received buffer data to a UART device.

config ZSTREAMER_UART_DMA
	bool "UART DMA/async support"
	default y
	depends on UART_ASYNC_API
	depends on (ZSTREAMER_UART_SRC || ZSTREAMER_UART_SINK)
	help
	  Enable DMA/async UART support for zstreamer drivers.
	  When enabled, UART source and sink nodes will automatically
	  use DMA transfers when available, falling back to polling
	  if the UART device doesn't support async API.

config ZSTREAMER_UART_DMA_MAX_CONTEXTS
	int "Maximum number of UART DMA contexts"
	default 4
	depends on ZSTREAMER_UART_DMA
	help
	  Maximum number of UART devices that can simultaneously use
	  DMA with the shared context system. Each UART device that
	  has both a source and sink node sharing DMA uses one context.

config ZSTREAMER_UART_DMA_RX_BUF_SIZE
	int "UART DMA RX buffer size"
	default 256
	depends on ZSTREAMER_UART_DMA
	help
	  Size in bytes of the DMA receive buffer for UART source nodes.
	  Larger buffers can reduce interrupt overhead but use more RAM.
```

## drivers/util/Kconfig
```kconfig
# Copyright (c) 2026 sharonthecreator
# SPDX-License-Identifier: Apache-2.0

config ZSTREAMER_UTIL
	bool

config ZSTREAMER_UTIL_LOOPER_NODE
	bool "Looper processor node driver"
	depends on DT_HAS_ZSTREAMER_LOOPER_NODE_ENABLED
	depends on ZSTREAMER
	select ZSTREAMER_UTIL
	help
	  Enable the looper processor node driver.
	  Retransmits each incoming buffer a configurable number of times,
	  e.g. for reliability over lossy transports.

config ZSTREAMER_UTIL_RANDOM_TIMER_SRC
	bool "Random timer source driver"
	depends on DT_HAS_ZSTREAMER_RANDOM_TIMER_SRC_ENABLED
	depends on ZSTREAMER
	select ZSTREAMER_UTIL
	help
	  Enable the random timer source streaming node driver.
	  Emits an empty buffer at random intervals between configurable
	  min and max seconds.
```

## drivers/zstnode/Kconfig
```kconfig
# Copyright (c) 2026 zstreamer contributors
# SPDX-License-Identifier: Apache-2.0

menuconfig ZSTNODE
	bool "zstnode driver support"
	depends on ZSTREAMER
	help
	  Enable zstnode driver subsystem. zstnode is the driver type
	  for streaming nodes in the zstreamer framework.

if ZSTNODE

module = ZSTNODE
module-str = zstnode
source "subsys/logging/Kconfig.template.log_config"

endif # ZSTNODE
```

## drivers/zstnode/adc/Kconfig
```kconfig
# Copyright (c) 2026 zstreamer contributors
# SPDX-License-Identifier: Apache-2.0

config ZSTNODE_ADC_SRC
	bool "ADC source zstnode driver"
	default y
	depends on DT_HAS_ZSTREAMER_ZSTSRC_ADC_ENABLED
	depends on ZSTNODE
	depends on ADC
	help
	  Enable the ADC source streaming node driver.
	  This driver captures ADC samples using timer-triggered DMA
	  for precise sample rates, suitable for audio capture.

if ZSTNODE_ADC_SRC

config ZSTNODE_ADC_STM32
	bool "STM32-specific ADC implementation"
	default y
	depends on SOC_FAMILY_STM32
	depends on DMA
	select USE_STM32_LL_ADC
	select USE_STM32_LL_TIM
	help
	  Use STM32-specific implementation for timer-triggered ADC
	  with DMA. This provides hardware-level integration between
	  timer TRGO and ADC external trigger for precise sampling.

config ZSTNODE_ADC_DMA_BUFFER_NOCACHE
	bool "Place ADC DMA buffer in non-cacheable region"
	default y
	depends on ZSTNODE_ADC_STM32
	depends on CPU_HAS_DCACHE
	help
	  On MCUs with data cache (e.g., STM32U5, STM32H7), DMA buffers
	  must be in non-cacheable memory. Enable this to allocate the
	  ADC DMA buffer in SRAM4 or another non-cacheable region.

endif # ZSTNODE_ADC_SRC
```

## drivers/zstnode/fs/Kconfig
```kconfig
# Copyright (c) 2026 sharonthecreator
# SPDX-License-Identifier: Apache-2.0

config ZSTNODE_FS_SINK
	bool "File system sink zstnode driver"
	default y
	depends on DT_HAS_ZSTREAMER_ZSTSINK_FS_ENABLED
	depends on ZSTNODE
	depends on FILE_SYSTEM
	help
	  Enable the file system sink streaming node driver.
	  Writes streamed data to files, rotating based on time or size.
```

## drivers/zstnode/spi/Kconfig
```kconfig
# Copyright (c) 2026 sharonthecreator
# SPDX-License-Identifier: Apache-2.0

config ZSTNODE_SPI_SRC
	bool "SPI source zstnode driver"
	default y
	depends on DT_HAS_ZSTREAMER_ZSTSRC_SPI_ENABLED
	depends on ZSTNODE
	depends on SPI
	help
	  Enable the SPI source streaming node driver.
	  Reads bytes from an SPI device (as master) and submits them
	  as buffers into the streaming graph.

config ZSTNODE_SPI_SINK
	bool "SPI sink zstnode driver"
	default y
	depends on DT_HAS_ZSTREAMER_ZSTSINK_SPI_ENABLED
	depends on ZSTNODE
	depends on SPI
	help
	  Enable the SPI sink streaming node driver.
	  Writes received buffer data to an SPI device (as master).

config ZSTNODE_SPI_DMA_RX_BUF_SIZE
	int "SPI DMA RX buffer size"
	default 256
	depends on SPI_ASYNC
	depends on ZSTNODE_SPI_SRC
	help
	  Size in bytes of the intermediate receive buffer used for
	  async SPI reads. Only used when SPI_ASYNC is available.
```
