## drivers/zstnode/test/Kconfig
```kconfig
# Copyright (c) 2026 sharonthecreator
# SPDX-License-Identifier: Apache-2.0

config ZSTNODE_TEST_NUMGEN_SRC
	bool "Number generator source zstnode driver"
	default y
	depends on DT_HAS_ZSTREAMER_ZSTSRC_NUMGEN_ENABLED
	depends on ZSTNODE
	help
	  Enable the number generator source streaming node driver.
	  Produces sequential bytes 0-255 (wrapping) to fill each buffer.

config ZSTNODE_TEST_FAKESINK
	bool "Fake sink zstnode driver"
	default y
	depends on DT_HAS_ZSTREAMER_ZSTSINK_FAKE_ENABLED
	depends on ZSTNODE
	help
	  Enable the fake sink streaming node driver.
	  Discards all received buffer data.
```

## drivers/zstnode/uart/Kconfig
```kconfig
# Copyright (c) 2026 sharonthecreator
# SPDX-License-Identifier: Apache-2.0

config ZSTNODE_UART_SRC
	bool "UART source zstnode driver"
	default y
	depends on DT_HAS_ZSTREAMER_ZSTSRC_UART_ENABLED
	depends on ZSTNODE
	depends on SERIAL
	help
	  Enable the UART source streaming node driver.
	  Reads bytes from a UART device and submits them
	  as buffers into the streaming graph.

config ZSTNODE_UART_SINK
	bool "UART sink zstnode driver"
	default y
	depends on DT_HAS_ZSTREAMER_ZSTSINK_UART_ENABLED
	depends on ZSTNODE
	depends on SERIAL
	help
	  Enable the UART sink streaming node driver.
	  Writes received buffer data to a UART device.

config ZSTNODE_UART_DMA
	bool "UART DMA/async support for zstnode"
	default y
	depends on UART_ASYNC_API
	depends on (ZSTNODE_UART_SRC || ZSTNODE_UART_SINK)
	help
	  Enable DMA/async UART support for zstnode drivers.
	  When enabled, UART source and sink nodes will automatically
	  use DMA transfers when available, falling back to polling
	  if the UART device doesn't support async API.

config ZSTNODE_UART_DMA_MAX_CONTEXTS
	int "Maximum number of UART DMA contexts"
	default 4
	depends on ZSTNODE_UART_DMA
	help
	  Maximum number of UART devices that can simultaneously use
	  DMA with the shared context system. Each UART device that
	  has both a source and sink node sharing DMA uses one context.

config ZSTNODE_UART_DMA_RX_BUF_SIZE
	int "UART DMA RX buffer size"
	default 256
	depends on ZSTNODE_UART_DMA
	help
	  Size in bytes of the DMA receive buffer for UART source nodes.
	  Larger buffers can reduce interrupt overhead but use more RAM.
```

## drivers/zstreamer/Kconfig
```kconfig
# Copyright (c) 2026 sharonthecreator
# SPDX-License-Identifier: Apache-2.0

rsource "uart/Kconfig"

rsource "spi/Kconfig"

rsource "adc/Kconfig"

rsource "fs/Kconfig"

rsource "test/Kconfig"
```

## drivers/zstreamer/adc/Kconfig
```kconfig
# Copyright (c) 2026 sharonthecreator
# SPDX-License-Identifier: Apache-2.0

config ZSTREAMER_ADC
	bool

config ZSTREAMER_ADC_SRC
	bool "ADC source driver"
	depends on DT_HAS_ZSTREAMER_ADC_SRC_ENABLED
	depends on ZSTREAMER
	depends on ADC
	select ZSTREAMER_ADC
	help
	  Enable the ADC source streaming node driver.
	  This driver captures ADC samples using timer-triggered DMA
	  for precise sample rates, suitable for audio capture.

if ZSTREAMER_ADC_SRC

config ZSTREAMER_ADC_STM32
	bool "STM32-specific ADC implementation"
	default y
	depends on SOC_FAMILY_STM32
	depends on DMA
	select USE_STM32_LL_ADC
	select USE_STM32_LL_TIM
	help
	  Use STM32-specific implementation for timer-triggered ADC
	  with DMA. This provides hardware-level integration between
	  timer TRGO and ADC external trigger for precise sampling.

config ZSTREAMER_ADC_DMA_BUFFER_NOCACHE
	bool "Place ADC DMA buffer in non-cacheable region"
	default y
	depends on ZSTREAMER_ADC_STM32
	depends on CPU_HAS_DCACHE
	help
	  On MCUs with data cache (e.g., STM32U5, STM32H7), DMA buffers
	  must be in non-cacheable memory. Enable this to allocate the
	  ADC DMA buffer in SRAM4 or another non-cacheable region.

endif # ZSTREAMER_ADC_SRC
```

## drivers/zstreamer/fs/Kconfig
```kconfig
# Copyright (c) 2026 sharonthecreator
# SPDX-License-Identifier: Apache-2.0

config ZSTREAMER_NODE_FS_SINK
	bool "File system sink zstreamer_node driver"
	default y
	depends on DT_HAS_ZSTREAMER_SINK_FS_ENABLED
	depends on ZSTREAMER_NODE
	depends on FILE_SYSTEM
	help
	  Enable the file system sink streaming node driver.
	  Writes streamed data to files, rotating based on time or size.
```

## drivers/zstreamer/pwm/Kconfig
```kconfig
# Copyright (c) 2026 sharonthecreator
# SPDX-License-Identifier: Apache-2.0

config ZSTREAMER_PWM
	bool

config ZSTREAMER_PWM_SINK
	bool "PWM sink driver"
	depends on DT_HAS_ZSTREAMER_PWM_SINK_ENABLED
	depends on ZSTREAMER
	depends on PWM
	select ZSTREAMER_PWM
	help
	  Enable the PWM sink streaming node driver.
	  Maps the mean byte value of received buffers to a PWM duty cycle.
```

## drivers/zstreamer/spi/Kconfig
```kconfig
# Copyright (c) 2026 sharonthecreator
# SPDX-License-Identifier: Apache-2.0

config ZSTREAMER_NODE_SPI_SRC
	bool "SPI source zstreamer_node driver"
	default y
	depends on DT_HAS_ZSTREAMER_SRC_SPI_ENABLED
	depends on ZSTREAMER_NODE
	depends on SPI
	help
	  Enable the SPI source streaming node driver.
	  Reads bytes from an SPI device (as master) and submits them
	  as buffers into the streaming graph.

config ZSTREAMER_NODE_SPI_SINK
	bool "SPI sink zstreamer_node driver"
	default y
	depends on DT_HAS_ZSTREAMER_SINK_SPI_ENABLED
	depends on ZSTREAMER_NODE
	depends on SPI
	help
	  Enable the SPI sink streaming node driver.
	  Writes received buffer data to an SPI device (as master).

config ZSTREAMER_NODE_SPI_DMA_RX_BUF_SIZE
	int "SPI DMA RX buffer size"
	default 256
	depends on SPI_ASYNC
	depends on ZSTREAMER_NODE_SPI_SRC
	help
	  Size in bytes of the intermediate receive buffer used for
	  async SPI reads. Only used when SPI_ASYNC is available.
```
